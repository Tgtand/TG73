## config/boards/shields/TG73/Kconfig.defconfig
```kconfig
# SPDX-License-Identifier: MIT

if SHIELD_TG73

config ZMK_KEYBOARD_NAME
    default "TG73"

config ZMK_USB
    default y

config ZMK_BLE
    default y

endif
```

## config/boards/shields/TG73/Kconfig.shield
```kconfig
# Copyright (c) 2020 The ZMK Contributors
# SPDX-License-Identifier: MIT

config SHIELD_TG73
	def_bool $(shields_list_contains,TG73)
```
